## Documentation/devicetree/bindings/phy/qcom,sa8775p-csi2-phy.yaml
```yaml
# SPDX-License-Identifier: (GPL-2.0 OR BSD-2-Clause)
%YAML 1.2
---
$id: http://devicetree.org/schemas/phy/qcom,sa8775p-csi2-phy.yaml#
$schema: http://devicetree.org/meta-schemas/core.yaml#

title: Qualcomm SA8775P CSI2 PHY

maintainers:
  - Anusha Arun Nandi <anusha.nandi@oss.qualcomm.com>

description:
  Qualcomm MIPI CSI2 D-PHY. Connects MIPI CSI2 sensors to Qualcomm's Camera
  CSI Decoder on the SA8775P (lemans) SoC.

properties:
  compatible:
    const: qcom,sa8775p-csi2-phy

  reg:
    maxItems: 1

  "#phy-cells":
    const: 1
    description:
      The single cell specifies the PHY operating mode.
      See include/dt-bindings/phy/phy-qcom-mipi-csi2.h for valid values.

  clocks:
    maxItems: 3

  clock-names:
    items:
      - const: csiphy
      - const: csiphy_timer
      - const: csiphy_rx

  interrupts:
    maxItems: 1

  vdda-phy-supply:
    description: Phandle to PHY supply.

  vdda-pll-supply:
    description: Phandle to PLL supply.

required:
  - compatible
  - reg
  - "#phy-cells"
  - clocks
  - clock-names
  - interrupts
  - vdda-phy-supply
  - vdda-pll-supply

additionalProperties: false

examples:
  - |
    #include <dt-bindings/interrupt-controller/arm-gic.h>
    #include <dt-bindings/clock/qcom,sa8775p-camcc.h>
    #include <dt-bindings/phy/phy-qcom-mipi-csi2.h>

    csiphy0: csiphy@ac9c000 {
        compatible = "qcom,sa8775p-csi2-phy";
        reg = <0x0ac9c000 0x2000>;
        #phy-cells = <1>;

        clocks = <&camcc CAM_CC_CSIPHY0_CLK>,
                 <&camcc CAM_CC_CSI0PHYTIMER_CLK>,
                 <&camcc CAM_CC_CSID_CSIPHY_RX_CLK>;
        clock-names = "csiphy",
                      "csiphy_timer",
                      "csiphy_rx";

        interrupts = <GIC_SPI 477 IRQ_TYPE_EDGE_RISING>;

        vdda-phy-supply = <&vreg_l4a>;
        vdda-pll-supply = <&vreg_l1c>;
    };

    isp@ac78000 {
        phys = <&csiphy0 PHY_QCOM_CSI2_MODE_DPHY>;
    };
```

## drivers/media/i2c/imx686/Kconfig
```kconfig
config VIDEO_IMX686
       tristate "Sony IMX686 sensor support"
       depends on OF_GPIO
       depends on VIDEO_V4L2_I2C
       select VIDEO_V4L2_SUBDEV_API
       select MEDIA_CONTROLLER
       select V4L2_FWNODE
       help
         This is a Video4Linux2 sensor driver for the Sony
         IMX686 camera.

         To compile this driver as a module, choose M here: the
         module will be called imx686.
```
